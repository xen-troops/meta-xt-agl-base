## conf/layer.conf
```bitbake
# We have a conf and classes directory, add to BBPATH
BBPATH =. "${LAYERDIR}:"

# We have recipes-* directories, add to BBFILES
BBFILES += "${LAYERDIR}/recipes-*/*/*.bb \
            ${LAYERDIR}/recipes-*/*/*.bbappend"

BBFILE_COLLECTIONS += "meta-xt-agl-base"
BBFILE_PATTERN_meta-xt-agl-base = "^${LAYERDIR}/"
BBFILE_PRIORITY_meta-xt-agl-base = "6"

LAYERSERIES_COMPAT_meta-xt-agl-base = "rocko sumo thud zeus dunfell"
```
